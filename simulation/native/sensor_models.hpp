// Project Setu - Realistic MPU6050, GNSS, Motion & Positioning Sensor Models
// Models physical inertial sensing, GNSS satellite reception/outages,
// dead-reckoning integration, and strict ground-truth vs estimation separation.
#pragma once

#ifndef _USE_MATH_DEFINES
#define _USE_MATH_DEFINES
#endif
#include <cmath>
#ifndef M_PI
#define M_PI 3.14159265358979323846
#endif

#include <cstdint>
#include <cstddef>
#include <string>
#include <vector>
#include <random>
#include <algorithm>
#include <deque>

namespace sim {

/**
 * Human-worn device motion profiles.
 * Used for experimental inertial sensing and dead-reckoning simulation.
 */
enum class MotionProfile : uint8_t {
  Stationary = 0,
  Walking = 1,
  Running = 2,
  SuddenMovement = 3,
  FallImpact = 4,
  Irregular = 5
};

inline const char* motion_profile_str(MotionProfile p) {
  switch (p) {
    case MotionProfile::Stationary: return "stationary";
    case MotionProfile::Walking: return "walking";
    case MotionProfile::Running: return "running";
    case MotionProfile::SuddenMovement: return "sudden_movement";
    case MotionProfile::FallImpact: return "fall_impact";
    case MotionProfile::Irregular: return "irregular";
    default: return "unknown";
  }
}

/**
 * 3-Axis IMU sensor sample generated by the physical sensor model.
 */
struct ImuSample {
  uint32_t timestamp_ms = 0;
  // Physical measurements in standard SI units (m/s^2 and rad/s)
  double ax = 0.0, ay = 0.0, az = 9.80665; // includes gravity vector
  double gx = 0.0, gy = 0.0, gz = 0.0;     // angular velocity in rad/s
  // Exact 16-bit raw signed integer readings matching MPU-6050 registers (0x3B..0x48)
  // Default scale: +/- 4g (8192 LSB/g) and +/- 500 deg/s (65.5 LSB/(deg/s))
  int16_t raw_ax = 0, raw_ay = 0, raw_az = 8192;
  int16_t raw_gx = 0, raw_gy = 0, raw_gz = 0;
  bool step_detected = false;
  float step_length_m = 0.0f;
  float heading_rad = 0.0f;
};

/**
 * MPU6050 6-Axis Inertial Sensor Model.
 * Simulates 3-axis accelerometer, 3-axis gyroscope, gravity vector projection,
 * orientation, bias drift, Gaussian noise, quantization, and step impulses.
 */
class Mpu6050SensorModel {
 public:
  static constexpr double kGravity = 9.80665;
  static constexpr double kAccelLsbPerG = 8192.0;       // +/- 4g mode
  static constexpr double kGyroLsbPerDegS = 65.5;      // +/- 500 deg/s mode
  static constexpr double kDegToRad = M_PI / 180.0;
  static constexpr double kRadToDeg = 180.0 / M_PI;

  Mpu6050SensorModel(uint32_t seed = 42)
      : rng_(seed), gauss_(0.0, 1.0) {
    // Initial stochastic sensor bias offsets
    accel_bias_x_ = 0.02 * gauss_(rng_);
    accel_bias_y_ = 0.02 * gauss_(rng_);
    accel_bias_z_ = 0.03 * gauss_(rng_);
    gyro_bias_z_ = 0.005 * gauss_(rng_);
  }

  void set_profile(MotionProfile p) { profile_ = p; }
  MotionProfile profile() const { return profile_; }

  void set_orientation(double pitch_rad, double roll_rad, double yaw_rad) {
    pitch_ = pitch_rad;
    roll_ = roll_rad;
    yaw_ = yaw_rad;
  }

  double current_heading_rad() const { return yaw_; }
  void set_heading_rad(double h) { yaw_ = h; }

  /**
   * Generates a realistic physical MPU6050 sensor sample at current simulation time.
   */
  ImuSample update(uint32_t now_ms, double gt_speed_mps = 0.0) {
    ImuSample s;
    s.timestamp_ms = now_ms;

    // 1. Base gravity vector in body frame: [0, 0, g] rotated by pitch/roll
    double grav_x = -kGravity * std::sin(pitch_);
    double grav_y = kGravity * std::sin(roll_) * std::cos(pitch_);
    double grav_z = kGravity * std::cos(roll_) * std::cos(pitch_);

    // 2. Dynamics synthesis based on motion profile
    double dyn_ax = 0.0, dyn_ay = 0.0, dyn_az = 0.0;
    double dyn_gz = 0.0;
    bool step_event = false;
    float step_dist = 0.0f;

    double dt = (last_ms_ == 0) ? 0.01 : (now_ms - last_ms_) * 0.001;
    if (dt <= 0.0 || dt > 0.5) dt = 0.01;
    last_ms_ = now_ms;
    phase_ += dt * profile_frequency_hz();

    switch (profile_) {
      case MotionProfile::Stationary:
        // Micro-tremor only
        dyn_ax = 0.01 * std::sin(phase_ * 2.0 * M_PI * 8.0);
        dyn_ay = 0.01 * std::cos(phase_ * 2.0 * M_PI * 8.0);
        break;

      case MotionProfile::Walking: {
        // ~1.8 Hz cadence, periodic forward/vertical acceleration, arm swing
        double f = 1.8;
        double omega = 2.0 * M_PI * f;
        dyn_az = 0.45 * kGravity * std::sin(phase_ * omega); // vertical bounce
        dyn_ay = 0.25 * kGravity * std::cos(phase_ * omega * 0.5); // arm swing
        dyn_ax = 0.20 * kGravity * std::sin(phase_ * omega); // forward surge
        dyn_gz = 0.15 * std::sin(phase_ * omega * 0.5);      // yaw oscillation

        // Peak step detection interval (~550 ms)
        if (now_ms - last_step_ms_ >= 550) {
          last_step_ms_ = now_ms;
          step_event = true;
          step_dist = 0.72f; // average human stride
        }
        break;
      }

      case MotionProfile::Running: {
        // ~2.8 Hz cadence, higher impact forces (>2.5g total)
        double f = 2.8;
        double omega = 2.0 * M_PI * f;
        dyn_az = 1.4 * kGravity * std::sin(phase_ * omega);
        dyn_ay = 0.6 * kGravity * std::cos(phase_ * omega * 0.5);
        dyn_ax = 0.5 * kGravity * std::sin(phase_ * omega);
        dyn_gz = 0.35 * std::sin(phase_ * omega * 0.5);

        if (now_ms - last_step_ms_ >= 350) {
          last_step_ms_ = now_ms;
          step_event = true;
          step_dist = 1.15f; // running stride
        }
        break;
      }

      case MotionProfile::SuddenMovement: {
        // Transient sharp jolt
        double t_rel = (now_ms % 3000) * 0.001;
        if (t_rel < 0.3) {
          dyn_ax = 1.8 * kGravity * std::sin(t_rel * 20.0);
          dyn_ay = 1.2 * kGravity * std::cos(t_rel * 20.0);
          dyn_gz = 1.5 * std::sin(t_rel * 15.0);
        }
        break;
      }

      case MotionProfile::FallImpact: {
        // Freefall (~0g) followed by massive impact peak (>3.5g) then stillness
        uint32_t cycle = now_ms % 8000;
        if (cycle < 400) {
          // Freefall dip
          dyn_az = -0.85 * kGravity;
          dyn_ax = -0.85 * grav_x;
          dyn_ay = -0.85 * grav_y;
        } else if (cycle >= 400 && cycle < 600) {
          // Impact spike
          dyn_az = 3.8 * kGravity;
          dyn_ax = 2.2 * kGravity;
          dyn_ay = 1.9 * kGravity;
          dyn_gz = 4.2;
        } else {
          // Post-fall immobility
          dyn_ax = 0.005 * gauss_(rng_);
          dyn_ay = 0.005 * gauss_(rng_);
          dyn_az = 0.005 * gauss_(rng_);
        }
        break;
      }

      case MotionProfile::Irregular: {
        // Chaotic traversal over disaster rubble
        dyn_az = 0.6 * kGravity * std::sin(phase_ * 3.1) + 0.3 * kGravity * gauss_(rng_);
        dyn_ax = 0.4 * kGravity * std::cos(phase_ * 2.3) + 0.2 * kGravity * gauss_(rng_);
        dyn_ay = 0.4 * kGravity * std::sin(phase_ * 1.7);
        dyn_gz = 0.3 * gauss_(rng_);

        if (now_ms - last_step_ms_ >= 650 + (rng_() % 300)) {
          last_step_ms_ = now_ms;
          step_event = true;
          step_dist = 0.55f + 0.2f * static_cast<float>(gauss_(rng_));
          yaw_ += 0.15 * gauss_(rng_); // heading perturbation
        }
        break;
      }
    }

    (void)gt_speed_mps;

    // 3. Add white noise & bias drift
    double noise_ax = 0.08 * gauss_(rng_); // ~80 mg noise
    double noise_ay = 0.08 * gauss_(rng_);
    double noise_az = 0.08 * gauss_(rng_);
    double noise_gz = 0.015 * gauss_(rng_); // ~0.8 deg/s noise

    s.ax = grav_x + dyn_ax + accel_bias_x_ + noise_ax;
    s.ay = grav_y + dyn_ay + accel_bias_y_ + noise_ay;
    s.az = grav_z + dyn_az + accel_bias_z_ + noise_az;
    s.gz = dyn_gz + gyro_bias_z_ + noise_gz;
    s.gx = 0.02 * gauss_(rng_);
    s.gy = 0.02 * gauss_(rng_);

    // 4. Quantization to 16-bit register LSBs with saturation clipping
    auto clamp_i16 = [](double v) -> int16_t {
      return static_cast<int16_t>(std::clamp(std::lround(v), -32768L, 32767L));
    };

    s.raw_ax = clamp_i16((s.ax / kGravity) * kAccelLsbPerG);
    s.raw_ay = clamp_i16((s.ay / kGravity) * kAccelLsbPerG);
    s.raw_az = clamp_i16((s.az / kGravity) * kAccelLsbPerG);

    s.raw_gx = clamp_i16((s.gx * kRadToDeg) * kGyroLsbPerDegS);
    s.raw_gy = clamp_i16((s.gy * kRadToDeg) * kGyroLsbPerDegS);
    s.raw_gz = clamp_i16((s.gz * kRadToDeg) * kGyroLsbPerDegS);

    // 5. Integrate gyro heading
    yaw_ += s.gz * dt;
    while (yaw_ > M_PI) yaw_ -= 2.0 * M_PI;
    while (yaw_ < -M_PI) yaw_ += 2.0 * M_PI;

    s.step_detected = step_event;
    s.step_length_m = step_dist;
    s.heading_rad = static_cast<float>(yaw_);
    return s;
  }

 private:
  double profile_frequency_hz() const {
    switch (profile_) {
      case MotionProfile::Walking: return 1.8;
      case MotionProfile::Running: return 2.8;
      case MotionProfile::Irregular: return 1.5;
      default: return 1.0;
    }
  }

  std::mt19937 rng_;
  std::normal_distribution<double> gauss_;

  MotionProfile profile_ = MotionProfile::Stationary;
  double pitch_ = 0.0;
  double roll_ = 0.0;
  double yaw_ = 0.0;

  double accel_bias_x_ = 0.0;
  double accel_bias_y_ = 0.0;
  double accel_bias_z_ = 0.0;
  double gyro_bias_z_ = 0.0;

  double phase_ = 0.0;
  uint32_t last_ms_ = 0;
  uint32_t last_step_ms_ = 0;
};

/**
 * GNSS Receiver Sensor Model.
 * Simulates satellite lock, dilution of precision (HDOP), delayed acquisition (TTFF),
 * realistic Gaussian positioning uncertainty, temporary outages, recovery,
 * and valid NMEA $GPRMC / $GPGGA string generation with strict XOR checksums.
 */
enum class GnssFixStatus : uint8_t {
  NoFix = 0,
  Acquiring = 1,
  ValidFix = 2,
  TemporaryOutage = 3,
  PoorQuality = 4,
  Recovered = 5
};

inline const char* gnss_status_str(GnssFixStatus s) {
  switch (s) {
    case GnssFixStatus::NoFix: return "no_fix";
    case GnssFixStatus::Acquiring: return "acquiring";
    case GnssFixStatus::ValidFix: return "valid_fix";
    case GnssFixStatus::TemporaryOutage: return "temporary_outage";
    case GnssFixStatus::PoorQuality: return "poor_quality";
    case GnssFixStatus::Recovered: return "recovered";
    default: return "unknown";
  }
}

class GnssSensorModel {
 public:
  static constexpr double kMPerDegLat = 111320.0;

  GnssSensorModel(uint32_t seed = 42)
      : rng_(seed), gauss_(0.0, 1.0) {}

  void set_status(GnssFixStatus s) { status_ = s; }
  GnssFixStatus status() const { return status_; }

  void schedule_outage(uint32_t start_ms, uint32_t duration_ms) {
    outage_start_ms_ = start_ms;
    outage_duration_ms_ = duration_ms;
  }

  /**
   * Updates GNSS receiver state and produces simulated noisy coordinates.
   * If valid fix, produces genuine NMEA $GPRMC string with checksum.
   */
  bool update(uint32_t now_ms, double gt_x, double gt_y,
              int32_t gt_lat_e6, int32_t gt_lon_e6,
              int32_t& out_lat_e6, int32_t& out_lon_e6,
              std::string* out_nmea = nullptr) {
    (void)gt_x;
    (void)gt_y;
    // 1. Check scheduled outage
    if (outage_duration_ms_ > 0 &&
        now_ms >= outage_start_ms_ &&
        now_ms < outage_start_ms_ + outage_duration_ms_) {
      status_ = GnssFixStatus::TemporaryOutage;
      return false;
    } else if (status_ == GnssFixStatus::TemporaryOutage &&
               outage_duration_ms_ > 0 &&
               now_ms >= outage_start_ms_ + outage_duration_ms_) {
      status_ = GnssFixStatus::Recovered;
    }

    if (status_ == GnssFixStatus::NoFix || status_ == GnssFixStatus::TemporaryOutage) {
      return false;
    }

    // 2. Compute satellite count and HDOP
    double hdop = 1.2;
    int sats = 9;
    double noise_sigma_m = 2.5; // nominal 2.5m 1-sigma GNSS horizontal error

    if (status_ == GnssFixStatus::PoorQuality) {
      hdop = 5.8;
      sats = 4;
      noise_sigma_m = 18.0; // severe multipath or canyon effect
    } else if (status_ == GnssFixStatus::Acquiring) {
      return false; // Still searching
    }

    // 3. Add Gaussian measurement noise to ground-truth coordinates
    double err_x = noise_sigma_m * gauss_(rng_);
    double err_y = noise_sigma_m * gauss_(rng_);

    // Convert to microdegrees relative to ground truth
    double dlat_deg = err_y / kMPerDegLat;
    double dlon_deg = err_x / (kMPerDegLat * std::cos((gt_lat_e6 * 1e-6) * M_PI / 180.0));

    out_lat_e6 = gt_lat_e6 + static_cast<int32_t>(std::lround(dlat_deg * 1e6));
    out_lon_e6 = gt_lon_e6 + static_cast<int32_t>(std::lround(dlon_deg * 1e6));

    // 4. Optionally format as valid NMEA $GPRMC string with XOR checksum
    if (out_nmea) {
      *out_nmea = format_nmea_rmc(now_ms, out_lat_e6, out_lon_e6);
    }
    return true;
  }

  static std::string format_nmea_rmc(uint32_t now_ms, int32_t lat_e6, int32_t lon_e6) {
    double lat_deg = std::abs(lat_e6 * 1e-6);
    int lat_d = static_cast<int>(lat_deg);
    double lat_m = (lat_deg - lat_d) * 60.0;
    char ns = (lat_e6 >= 0) ? 'N' : 'S';

    double lon_deg = std::abs(lon_e6 * 1e-6);
    int lon_d = static_cast<int>(lon_deg);
    double lon_m = (lon_deg - lon_d) * 60.0;
    char ew = (lon_e6 >= 0) ? 'E' : 'W';

    uint32_t s = (now_ms / 1000u) % 86400u;
    uint32_t hh = s / 3600u;
    uint32_t mm = (s % 3600u) / 60u;
    uint32_t ss = s % 60u;

    char body[128];
    std::snprintf(body, sizeof(body),
                  "GPRMC,%02u%02u%02u.00,A,%02d%07.4f,%c,%03d%07.4f,%c,0.0,0.0,271026,,,A",
                  hh, mm, ss, lat_d, lat_m, ns, lon_d, lon_m, ew);

    // Compute NMEA XOR checksum
    uint8_t cs = 0;
    for (size_t i = 0; body[i] != '\0'; ++i) {
      cs ^= static_cast<uint8_t>(body[i]);
    }

    char sentence[160];
    std::snprintf(sentence, sizeof(sentence), "$%s*%02X\r\n", body, cs);
    return std::string(sentence);
  }

 private:
  std::mt19937 rng_;
  std::normal_distribution<double> gauss_;

  GnssFixStatus status_ = GnssFixStatus::ValidFix;
  uint32_t outage_start_ms_ = 0;
  uint32_t outage_duration_ms_ = 0;
};

/**
 * Strict ground-truth vs. estimated position metrics tracker.
 * Computes geodesic distance, Mean Absolute Error (MAE), Root Mean Square Error (RMSE),
 * and drift during GNSS outages.
 */
class PositionMetricsTracker {
 public:
  static constexpr double kMPerDegLat = 111320.0;

  void record_sample(double gt_x, double gt_y, int32_t gt_lat_e6, int32_t gt_lon_e6,
                     int32_t est_lat_e6, int32_t est_lon_e6, bool is_dr, bool is_gnss) {
    last_gt_x_ = gt_x;
    last_gt_y_ = gt_y;
    last_gt_lat_e6_ = gt_lat_e6;
    last_gt_lon_e6_ = gt_lon_e6;
    last_est_lat_e6_ = est_lat_e6;
    last_est_lon_e6_ = est_lon_e6;
    is_dr_ = is_dr;
    is_gnss_ = is_gnss;

    // Calculate current error in meters
    double dlat_m = (est_lat_e6 - gt_lat_e6) * 1e-6 * kMPerDegLat;
    double dlon_m = (est_lon_e6 - gt_lon_e6) * 1e-6 * kMPerDegLat * std::cos((gt_lat_e6 * 1e-6) * M_PI / 180.0);
    double err_m = std::hypot(dlat_m, dlon_m);

    current_error_m_ = err_m;
    sample_count_++;
    sum_error_m_ += err_m;
    sum_sq_error_m_ += (err_m * err_m);
    max_error_m_ = std::max(max_error_m_, err_m);

    if (is_dr) {
      dr_sample_count_++;
      sum_dr_error_m_ += err_m;
    }
  }

  double current_error_m() const { return current_error_m_; }
  double mae_m() const { return sample_count_ > 0 ? (sum_error_m_ / sample_count_) : 0.0; }
  double rmse_m() const { return sample_count_ > 0 ? std::sqrt(sum_sq_error_m_ / sample_count_) : 0.0; }
  double max_error_m() const { return max_error_m_; }
  double dr_mae_m() const { return dr_sample_count_ > 0 ? (sum_dr_error_m_ / dr_sample_count_) : 0.0; }
  size_t sample_count() const { return sample_count_; }

  int32_t last_gt_lat_e6() const { return last_gt_lat_e6_; }
  int32_t last_gt_lon_e6() const { return last_gt_lon_e6_; }
  int32_t last_est_lat_e6() const { return last_est_lat_e6_; }
  int32_t last_est_lon_e6() const { return last_est_lon_e6_; }
  bool is_dr_fallback() const { return is_dr_; }
  bool is_gnss_fix() const { return is_gnss_; }

 private:
  double last_gt_x_ = 0.0, last_gt_y_ = 0.0;
  int32_t last_gt_lat_e6_ = 0, last_gt_lon_e6_ = 0;
  int32_t last_est_lat_e6_ = 0, last_est_lon_e6_ = 0;
  bool is_dr_ = false;
  bool is_gnss_ = true;

  double current_error_m_ = 0.0;
  size_t sample_count_ = 0;
  double sum_error_m_ = 0.0;
  double sum_sq_error_m_ = 0.0;
  double max_error_m_ = 0.0;

  size_t dr_sample_count_ = 0;
  double sum_dr_error_m_ = 0.0;
};

/**
 * Multi-state realistic energy and power consumption model.
 * Uses exact datasheet values from ESP32-S3 and SX1262.
 */
class BatteryEnergyModel {
 public:
  // Datasheet currents in milliamperes (mA) at 3.7V nominal LiPo
  static constexpr double kCurrentStandbyMa = 2.7;        // 1.5mA MCU standby + 1.2mA SX1262 STDBY_RC
  static constexpr double kCurrentActiveCpuMa = 35.0;     // Core Task at 240 MHz
  static constexpr double kCurrentVoiceDspMa = 65.0;      // ESP-SR AFE/WakeNet active
  static constexpr double kCurrentRadioRxMa = 4.6;        // SX1262 DC-DC continuous RX
  static constexpr double kCurrentRadioTx14Ma = 45.0;     // SX1262 TX at +14 dBm
  static constexpr double kCurrentRadioTx22Ma = 118.0;    // SX1262 TX at +22 dBm
  static constexpr double kCurrentGnssMa = 45.0;          // NEO-6M active tracking
  static constexpr double kCurrentImuMa = 3.8;            // MPU-6050 6-axis active
  static constexpr double kCurrentHapticMa = 75.0;        // ERM eccentric vibration motor
  static constexpr double kCurrentLedMa = 8.0;            // Status LED

  BatteryEnergyModel(double capacity_mah = 300.0, uint8_t initial_pct = 100)
      : capacity_mah_(capacity_mah),
        remaining_mah_(capacity_mah * (std::min<uint8_t>(100, initial_pct) / 100.0)),
        initial_mah_(remaining_mah_) {}

  void consume_energy(double current_ma, double duration_ms) {
    if (duration_ms <= 0.0 || remaining_mah_ <= 0.0) return;
    double hours = duration_ms / 3600000.0;
    double mah = current_ma * hours;
    consumed_mah_ += mah;
    remaining_mah_ = std::max(0.0, remaining_mah_ - mah);
  }

  void account_tx(uint32_t airtime_ms, int8_t tx_power_dbm = 14) {
    double tx_ma = (tx_power_dbm >= 20) ? kCurrentRadioTx22Ma : kCurrentRadioTx14Ma;
    consume_energy(tx_ma, airtime_ms);
    tx_count_++;
  }

  void account_rx(uint32_t airtime_ms) {
    consume_energy(kCurrentRadioRxMa, airtime_ms);
    rx_count_++;
  }

  void account_idle(uint32_t duration_ms) {
    consume_energy(kCurrentStandbyMa + kCurrentImuMa, duration_ms);
  }

  void account_haptic(uint32_t duration_ms) {
    consume_energy(kCurrentHapticMa, duration_ms);
  }

  void account_voice_inference(uint32_t window_ms = 3500) {
    consume_energy(kCurrentVoiceDspMa, window_ms);
  }

  uint8_t percent() const {
    if (capacity_mah_ <= 0.0) return 0;
    return static_cast<uint8_t>(std::clamp(std::lround((remaining_mah_ / capacity_mah_) * 100.0), 0L, 100L));
  }

  double consumed_mah() const { return consumed_mah_; }
  double remaining_mah() const { return remaining_mah_; }
  double capacity_mah() const { return capacity_mah_; }
  uint32_t tx_count() const { return tx_count_; }
  uint32_t rx_count() const { return rx_count_; }

  void set_percent(uint8_t pct) {
    pct = std::min<uint8_t>(100, pct);
    remaining_mah_ = capacity_mah_ * (pct / 100.0);
    consumed_mah_ = capacity_mah_ - remaining_mah_;
  }

  /**
   * Estimates operating duration in hours under specified hourly transmission duty cycle.
   */
  double estimated_lifetime_hours(double tx_per_hour = 4.0, uint32_t airtime_ms = 115) const {
    double tx_duration_ms = tx_per_hour * airtime_ms;
    double idle_duration_ms = 3600000.0 - tx_duration_ms;
    double hourly_mah = (kCurrentRadioTx14Ma * (tx_duration_ms / 3600000.0)) +
                        ((kCurrentStandbyMa + kCurrentImuMa) * (idle_duration_ms / 3600000.0));
    return hourly_mah > 0.0 ? (remaining_mah_ / hourly_mah) : 0.0;
  }

 private:
  double capacity_mah_;
  double remaining_mah_;
  double initial_mah_;
  double consumed_mah_ = 0.0;
  uint32_t tx_count_ = 0;
  uint32_t rx_count_ = 0;
};

}  // namespace sim
